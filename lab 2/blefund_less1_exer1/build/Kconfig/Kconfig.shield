## lab 2/blefund_less1_exer1/build/Kconfig/Kconfig.shield
```kconfig
osource "/Users/dsalvador/Desktop/KU_LEUVEN/Software_for_Real_Time_and_Embedded_Systems/bt-fund/lesson1/blefund_less1_exer1/boards/shields/*/Kconfig.shield"
osource "/opt/nordic/ncs/v2.5.0-rc2/nrf/boards/shields/*/Kconfig.shield"
```

## lab 2/blefund_less1_exer1/build/Kconfig/Kconfig.sysbuild.modules
```kconfig
menu "nrf (/opt/nordic/ncs/v2.5.0-rc2/nrf)"
osource "/opt/nordic/ncs/v2.5.0-rc2/nrf/sysbuild/Kconfig.sysbuild"
config ZEPHYR_NRF_MODULE
	bool
	default y
endmenu
```
